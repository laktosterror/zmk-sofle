## config/west.yml
```yaml
# Every project is pinned to an exact commit so builds are reproducible and an
# upstream change (or compromised account) can't silently alter the firmware.
# To update: pick the new commit on the ref named in the comment, review it,
# and replace the hash. Example:
#   git ls-remote https://github.com/cormoran/zmk refs/heads/v0.3-branch+dya
manifest:
  remotes:
    - name: zmkfirmware
      url-base: https://github.com/zmkfirmware
    - name: cormoran
      url-base: https://github.com/cormoran
    - name: kevinpastor
      url-base: https://github.com/kevinpastor
  projects:
    - name: zmk
      remote: cormoran
      revision: 4493783ef88ce2e653bf8217c92ee17140df71e3 # branch v0.3-branch+dya
      import: app/west.yml
    - name: zmk-behavior-runtime-sensor-rotate
      remote: cormoran
      revision: 8b1125ed676c1f5e14145d217984f33d0ebdcef4 # branch main
    - name: zmk-module-ble-management
      remote: cormoran
      revision: 851661cd21f2aded8ec649da86e01a207dc4b973 # tag zmk-v0.3.0.0
    - name: zmk-module-battery-history
      remote: cormoran
      revision: 307755dd2ad4d320e14de162e8e5ef018f29d929 # branch main
    - name: zmk-module-settings-rpc
      remote: cormoran
      revision: 78f86df9e6c5edaf57bef3ccbd7f360cfdf49291 # branch main
    - name: zmk-module-runtime-input-processor
      remote: cormoran
      revision: dbf92f764de8b6ffd60bf5850514302875fe2570 # tag zmk-v0.3.0.0
    - name: nice-view-elemental
      remote: kevinpastor
      revision: 69c2ecd56b0b870ddb94b79110ef5a2152ca4a3a # branch main
  self:
    path: config
```
